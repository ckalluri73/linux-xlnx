## Documentation/devicetree/bindings/media/xilinx/xilinx-frmbuf-new.txt
```
The Xilinx framebuffer engine supports two soft IP blocks: one IP
block is used for reading video frame data from memory (FB Read) to the device
and the other IP block is used for writing video frame data from the device
to memory (FB Write).  Both the FB Read/Write IP blocks are aware of the
format of the data being written to or read from memory including RGB and
YUV in packed, planar, and semi-planar formats.  Because the FB Read/Write
is format aware, only one buffer pointer is needed by the IP blocks even
when planar or semi-planar format are used.

FB Write Required propertie(s):
- compatible		: Should be "xlnx,axi-frmbuf-wr-v2.1" or
			  "xlnx,axi-frmbuf-wr-v2.2". Older string
			  "xlnx,axi-frmbuf-wr-v2" is now deprecated.

Note: Compatible string "xlnx,axi-frmbuf-wr" and the hardware it
represented is no longer supported.

Required Properties Common to both FB Read and FB Write:
- #frmbuf-cells		: should be 1
- interrupt-parent	: Interrupt controller the interrupt is routed through
- interrupts		: Should contain FRMBUF channel interrupt
- reset-gpios		: Should contain GPIO reset phandle
- reg			: Memory map for module access
- xlnx,fb-addr-width	: Size of frmbuf address pointer in IP (either 32 or 64)
- xlnx,vid-formats	: A list of strings indicating what video memory
			  formats the IP has been configured to support.
			  See VIDEO FORMATS table below and examples.

Required Properties Common to both FB Read and FB Write for v2.1:
- xlnx,pixels-per-clock	: Pixels per clock set in IP (1, 2, 4 or 8)
- clocks: Reference to the AXI Streaming clock feeding the AP_CLK
- clock-names: Must have "ap_clk"
- xlnx,max-height	: Maximum number of lines.
			  Valid range from 64 to 8640.
- xlnx,max-width	: Maximum number of pixels in a line.
			  Valid range from 64 to 15360.

Optional Properties Common to both FB Read and FB Write for v2.1:
- xlnx,fb-align		: FRMBUF alignment required in bytes.
			  If absent then dma alignment is calculated as
			  pixels per clock * 8.
			  If present it should be power of 2 and at least
			  pixels per clock * 8.
			  Minimum is 8, 16, 32 when pixels-per-clock is
			  1, 2 or 4.
- xlnx,fid		: Field ID enabled for interlaced video support.
			  Can be absent for progressive video.

VIDEO FORMATS
The following table describes the legal string values to be used for
the xlnx,vid-formats property.  To the left is the string value and the
two columns to the right describe how this is mapped to an equivalent V4L2
and DRM fourcc code---respectively---by the driver.

IP FORMAT	DTS String	V4L2 Fourcc		
-------------|----------------|----------------------
RGB8		bgr888		V4L2_PIX_FMT_RGB24
BGR8		rgb888		V4L2_PIX_FMT_BGR24
RGBX8		xbgr8888	V4L2_PIX_FMT_BGRX32
RGBA8		abgr8888	<not supported>
BGRA8		argb8888	<not supported>
BGRX8		xrgb8888	V4L2_PIX_FMT_XBGR32
RGBX10		xbgr2101010	V4L2_PIX_FMT_XBGR30
RGBX12		xbgr2121212	V4L2_PIX_FMT_XBGR40
RGBX16		rgb16		V4L2_PIX_FMT_BGR40
YUV8		vuy888		V4L2_PIX_FMT_VUY24
YUVX8		xvuy8888	V4L2_PIX_FMT_XVUY32
Y_U_V8		y_u_v8		V4L2_PIX_FMT_YUV444P
Y_U_V8		y_u_v8		V4L2_PIX_FMT_YUV444M
Y_U_V10		y_u_v10		V4L2_PIX_FMT_X403
YUYV8		yuyv		V4L2_PIX_FMT_YUYV
UYVY8		uyvy		V4L2_PIX_FMT_UYVY
YUVA8		avuy8888	<not supported>
YUVX10		yuvx2101010	V4L2_PIX_FMT_XVUY10
Y8		y8		V4L2_PIX_FMT_GREY
Y10		y10		V4L2_PIX_FMT_XY10
Y_UV8		nv16		V4L2_PIX_FMT_NV16
Y_UV8		nv16		V4L2_PIX_FMT_NV16M
Y_UV8_420	nv12		V4L2_PIX_FMT_NV12
Y_UV8_420	nv12		V4L2_PIX_FMT_NV12M
Y_UV10		xv20		V4L2_PIX_FMT_XV20M
Y_UV10		xv20		V4L2_PIX_FMT_XV20
Y_UV10_420	xv15		V4L2_PIX_FMT_XV15M
Y_UV10_420	xv15		V4L2_PIX_FMT_XV20

Examples:

FB Write Example:
++++++++
v_frmbuf_wr_0: v_frmbuf_wr@80000000 {
	#fb-cells = <1>;
	compatible = "xlnx,axi-frmbuf-wr-v2.1";
	interrupt-parent = <&gic>;
	interrupts = <0 92 4>;
	reset-gpios = <&gpio 80 1>;
	reg = <0x0 0x80000000 0x0 0x10000>;
	xlnx,fb-addr-width = <64>;
	xlnx,vid-formats = "bgr888","yuyv","nv16","nv12";
	xlnx,pixels-per-clock = <2>;
	xlnx,fb-align = <16>;
	clocks = <&vid_stream_clk>;
	clock-names = "ap_clk"
};
```
